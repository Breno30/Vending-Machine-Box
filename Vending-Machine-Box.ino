
#include "secrets.h"
#include <WiFi.h>
#include <HTTPClient.h>
#include <Adafruit_GFX.h>
#include <Adafruit_SSD1306.h>
#include <ArduinoJson.h>
#include <qrcode_gen.h>
#include <WiFiClient.h>
#include <WebServer.h>
#include <math.h>

WebServer server(80);

const int port = 80;
const int qrCodeVersion = 11;
const int pixelSize = 1;
const unsigned char approved_icon[] PROGMEM = {0x00, 0x00, 0x00, 0x00, 0x00, 0x00, 0x00, 0x00, 0x00, 0x00, 0x00, 0x00, 0x00,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 0x00, 0x00};

const unsigned char product[] PROGMEM = {0, 0, 0, 0, 0, 0, 0, 0, 0, 0, 0, 0, 0,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 0, 0};
const unsigned char product1[] PROGMEM = {0, 0, 0, 0, 0, 0, 0, 0, 0, 0, 0, 0, 0,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 1, 0};
const unsigned char *productList[] PROGMEM = {product, product1};

int productIndex = 0;

#define SCREEN_WIDTH 128
#define SCREEN_HEIGHT 64
#define OLED_MOSI 23
#define OLED_CLK 18
#define OLED_DC 16
#define OLED_CS 5
#define OLED_RESET 17

#define bounceDelay 20 
#define minButtonPress 3 
const int buttonPin = 27;
uint32_t previousMillis = 0;
uint8_t pressCount = 0;
uint8_t testCount = 0;

Adafruit_SSD1306 display(SCREEN_WIDTH, SCREEN_HEIGHT, OLED_MOSI, OLED_CLK, OLED_DC, OLED_RESET, OLED_CS);

void setup()
{

  Serial.begin(9600);
  pinMode(buttonPin, INPUT_PULLUP);

  // Start display
  display.begin(SSD1306_SWITCHCAPVCC);
  showProduct(productIndex % 2);

  // Connects to wifi
  WiFi.begin(ssid, password);

  while (WiFi.status() != WL_CONNECTED)
  {
    delay(1000);
  }

  if (WiFi.status() != WL_CONNECTED)
  {
    Serial.println("Error in WiFi connection");
    return;
  }

  // Handle webhook
  server.on("/", HTTP_GET, handleWebhook);
  server.begin();

  // Create a transaction
  HTTPClient http;
  http.begin(String(hostName) + "/api/transactions");
  http.addHeader("Content-Type", "application/json");

  // Define and populate a JSON document
  StaticJsonDocument<200> doc;
  doc["machine_id"] = 2;
  doc["product_id"] = 88;
  doc["price"] = 0.01;

  // Serialize the JSON document into a string
  String jsonPayload;
  serializeJson(doc, jsonPayload);

  // Send request creating transaction
  int httpResponseCode = http.POST(jsonPayload);

  if(httpResponseCode!=201){
    Serial.print("Error on sending POST: ");
    Serial.println(httpResponseCode);
    return;
  }

  String response = http.getString();

  Serial.println(httpResponseCode + response);

  StaticJsonDocument<200> responseJson;
  deserializeJson(responseJson, response);

  const char* pixQrCode = responseJson["qr_code"];

  showQRCode(pixQrCode);

  http.end();
}

void loop()
{
  // Keep listening to webhook
  server.handleClient();
  listenToButton();
  delay(10);
}

void handleWebhook()
{
  Serial.println("Webhook received!");
  String body = server.arg("success");
  Serial.println("Body: " + body);
  showApproved();
  server.send(200, "text/plain", "Webhook received successfully");
}

void listenToButton()
{
  uint32_t currentMillis = millis();

  if (digitalRead(buttonPin))
  {
    previousMillis = currentMillis; // Set previousMillis to millis to reset timeout
    pressCount = 0;
    return;
  }

  if (currentMillis - previousMillis <= bounceDelay)
  {
    return; // Return early if bouncing
  }

  previousMillis = currentMillis; // Set previousMillis to millis to reset timeout
  ++pressCount;

  if (pressCount == minButtonPress)
  {
    doStuff();
  }
}

void doStuff()
{
  productIndex++;
  showProduct(productIndex % 2);
  Serial.print("Button ");
}

void showApproved()
{
  display.clearDisplay();
  display.drawBitmap(0, 0, approved_icon, SCREEN_WIDTH, SCREEN_HEIGHT, SSD1306_WHITE);
  display.display();
}

void showProduct(int productIndex)
{
  display.clearDisplay();

  int pixelsPerRow = 64;
  int pixelsPerCol = 96;

  for (int i = 0; i < pixelsPerRow * pixelsPerCol; i++)
  {
    int x = floor(i / pixelsPerRow);
    int y = i % pixelsPerRow;

    if (productList[productIndex][i])
    {
      display.drawPixel(x, y, SSD1306_WHITE);
    }
  }

  display.display();
}

void showQRCode(String qrCodeString)
{
  display.clearDisplay();

  QRCode qrcode;

  uint8_t qrcodeBytes[qrcode_getBufferSize(qrCodeVersion)];
  qrcode_initText(&qrcode, qrcodeBytes, qrCodeVersion, ECC_LOW,
                  qrCodeString.c_str());

  display.clearDisplay();

  int startX = (SCREEN_WIDTH - (qrcode.size * pixelSize) - (pixelSize * 2)) / 2;
  int startY = (SCREEN_HEIGHT - (qrcode.size * pixelSize) - (pixelSize * 2)) / 2;

  int qrCodeSize = qrcode.size;

  display.fillRect(startX, startY, (qrCodeSize * pixelSize) + (pixelSize * 2),
                   (qrCodeSize * pixelSize) + (pixelSize * 2), SSD1306_WHITE);

  for (uint8_t y = 0; y < qrCodeSize; y++)
  {
    for (uint8_t x = 0; x < qrCodeSize; x++)
    {
      if (qrcode_getModule(&qrcode, x, y))
      {
        display.fillRect(x * pixelSize + startX + pixelSize,
                         y * pixelSize + startY + pixelSize, pixelSize,
                         pixelSize, SSD1306_BLACK);
      }
    }
  }
  display.display();
}
